/***************************************************************************************************
  * 文    件：Timer.c   
  * 作    者：longwei
  * 编写日期：2012/7/7
  * 版    本：V1.0
  * 开 发 板：MSP430G2553 TI开发板
  * 修改时间：2012/7/14 
  * 编 译 器: IAR.5.20
  *-------------------------------------------------------------------------------------------------
  * 简    介：与比较器配合实现电阻的测量， 比较器输出信号通过Time_A CCI1B捕获   
  *           定时器时钟源选择SMCLK8分频，即1MHz ,外部电容1uF,测量范围1K~10K
              先测被测电阻，再测参考电阻
  *************************************************************************************************/
/*包含--------------------------------------------------------------------------------------------*/
#include "Timer.h"
/* 私有定义结构体 --------------------------------------------------------------------------------*/
/* 私有宏-----------------------------------------------------------------------------------------*/
#define Capture_M_Num 6//一个电阻的测量次数
#define Capture_M_Two_Num Capture_M_Num*2
#define Charging_Time 60 //单位为ms
#define Rref 1000//1000Ω//实际值为988Ω属于误差校正
/* 全局变量---------------------------------------------------------------------------------------*/
uint16_t Capture_M[Capture_M_Two_Num];
uint8_t RM_Type; //0，表示测量被测电阻，1：表示测量参考电阻
uint8_t Cap_Offset;//捕获偏量
/* 私有函数模型 ----------------------------------------------------------------------------------*/
/***************************************************************************************************
  * 描述   :  时基配置
  * 参数   :  无
  * 返回   :  无
  * 注意   :
  *************************************************************************************************/
void Timer_Base_Conf(void)
{
  R_M_IO_DIR;
  Rr_Hi_Z;
  Rm_Hi_Z;
  RM_Type=0;//先测被测电阻
  Cap_Offset=0;
  F_M_Start();
}
/***************************************************************************************************
  * 描述   :  开始一次测量
  * 参数   :  F_Mset：全局变量，随测量档位的不同时基配置跟着改变
  * 返回   :  无
  * 注意   :  捕获来值比较器输出的信号
  *************************************************************************************************/
void F_M_Start(void)
{
  if(RM_Type==0)//测量被测电阻
  {
    Rr_Hi_Z;
    Rm_IO;
    R_meas_1;
    delay_ms(Charging_Time);//等待充电完成
    TA0CTL   =TASSEL_2+ID_3+TACLR+TAIE; 
    TA0CCTL1 =CM_2+CCIS_1+SCS+CAP+CCIE; //CCI1B捕获
    R_meas_0;
    TA0CTL |= MC_2;            //contmode
  }
  else
  {
    Rm_Hi_Z;
    Rr_IO;
    R_ref_1;
    delay_ms(Charging_Time);//等待充电完成
    TA0CTL   =TASSEL_2+ID_3+TACLR+TAIE; 
    TA0CCTL1 =CM_2+CCIS_1+SCS+CAP+CCIE; //CCI1B捕获
    R_ref_0;
    TA0CTL |= MC_2;            //contmode
  }
}
/***************************************************************************************************
  * 描述   :  电阻测量，并显示
  * 参数   :  全局变量捕获数组
  * 返回   :  无
  * 注意   :  测量公式：Rmeas=Rref*Nm/Nr
  *************************************************************************************************/
void F_Measure(void)
{
  uint8_t i;
  uint32_t Nm=0,Nr=0;
  float Rmeas;
  for(i=0;i<Capture_M_Num;i++)
   Nm+=Capture_M[i];
  for(;i<Capture_M_Two_Num;i++)
   Nr+=Capture_M[i];
  Rmeas=(Nm/(float)Nr)*Rref;
  LCD_LineClear(2);
  Display_Str(2,6,"Ω");
  LCD_Display_FloatNum(2,2,Rmeas,8);
}
/***************************************************************************************************
  * 描述   :  定时器中断服务函数
  * 参数   :  无
  * 返回   :  无
  * 注意   :  Timer A0 interrupt service routine
  *************************************************************************************************/
#pragma vector=TIMER0_A1_VECTOR
__interrupt void Timer_A1 (void)
{
  switch(__even_in_range(TA0IV, 10))       // Efficient switch-implementation
  {
    case  2:                         // TA0CCR1 测量频率
        {
          Capture_M[Cap_Offset++]=TA0CCR1;
          TA0CCTL1&=0X3FFF;
          TA0CTL&=0XFFCF;//Stop
          if(Cap_Offset==Capture_M_Num)//一个电阻测量完成
          {
            RM_Type=1;//切换到测量参考电阻
          }
          else if(Cap_Offset==Capture_M_Two_Num)//全部测量完成
          {
            F_Measure(); 
            RM_Type=0;//切换到测量被测电阻
            Cap_Offset=0;
          }
          F_M_Start();    
          break; 
        }
    case  4: break;                        // TA0CCR2 not used
    case 10:
       {
          TA0CCTL1&=0X3FFF;
          TA0CTL&=0XFFCF;//Stop
          F_M_Start();
          break;                        // TA0IE   not used
       }
  }
}

/******************* (C) 版权 2012 longwei *****文件结束*******************************************/
