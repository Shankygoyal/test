/***************************************************************************************************
  * 文    件：LCD_12864.c    
  * 作    者：longwei
  * 编写日期：2012/7/9
  * 版    本：V1.0
  * 开 发 板：MSP430G2553 TI开发板
  * 修改时间：2012/7/15 
  * 编 译 器: IAR.5.20
  *-------------------------------------------------------------------------------------------------
  * 简    介：     
  *************************************************************************************************/

/*包含--------------------------------------------------------------------------------------------*/
#include "LCD_12864.h"
/* 私有定义结构体 --------------------------------------------------------------------------------*/

/* 私有宏-----------------------------------------------------------------------------------------*/
//12864液晶写间隔延时us数
#define LCD_Interval_Delay 75
/* 私有变量 --------------------------------------------------------------------------------------*/
/* 私有函数模型 ----------------------------------------------------------------------------------*/
static void LCD_SendByte(uint8_t Data);
static void Lcd_Write_Data(uint8_t Data);
static void Lcd_Write_Cmd(uint8_t Cmdcode);
/***************************************************************************************************
  * 描述   : LCD_12864初始化
  * 参数   : 无
  * 返回   : 无
  * 注意   : 
   *************************************************************************************************/
void LCD_Init(void)
{
  LCD_IO_DIR;
  delay_us(500);
  Lcd_Write_Cmd(0x30);        //设置为基本指令模式
  Lcd_Write_Cmd(0x02);        // 地址归位
  Lcd_Write_Cmd(0x0c);        //设置开显示，不显示光标
  Lcd_Write_Cmd(0x06);         //游标右移
  Lcd_Write_Cmd(0x01);        //清屏：显示清0，数据指针清0
  Lcd_Write_Cmd(0x80);        //设定显示的起始地址
  delay_ms(10);
}
/***************************************************************************************************
  * 描述   : LCD_12864清屏
  * 参数   : 无
  * 返回   : 无
  * 注意   : 
   *************************************************************************************************/
void LCD_Clear(void)
{ 
  Lcd_Write_Cmd(0x02);        // 地址归位
  Lcd_Write_Cmd(0x0c);        //设置开显示，不显示光标
  Lcd_Write_Cmd(0x06);         //游标右移
  Lcd_Write_Cmd(0x01);        //清屏：显示清0，数据指针清0
  Lcd_Write_Cmd(0x80);        //设定显示的起始地址
  delay_ms(10);
}
/***************************************************************************************************
  * 描述   : LCD_12864 定位函数
  * 参数   : Line:行 Column：列 Column范围 0~7  Line范围 0~3
  * 返回   : 无
  * 注意   : 
   *************************************************************************************************/
void LCD_Pos(uint8_t Line,uint8_t Column)
{
  uint8_t adr;
  adr = (0x80+Column);                //计算出x坐标
  switch(Line)                        //计算出y坐标
  {
      case 0:                     	//第1行
          break;      				
      case 1:                     	//第2行
          adr = adr+16;break;  
      case 2:                      	//第3行
          adr = adr+8;break;
      case 3:                     	//第4行
          adr = adr+24;break;
      default:
          break;
  }
  Lcd_Write_Cmd(adr);  //设定DDRAM位址到位址计数器  
}
/***************************************************************************************************
  * 描述   : LCD_12864 清除行
  * 参数   : Line  0~3
  * 返回   : 无
  * 注意   : 
   *************************************************************************************************/
void LCD_LineClear(uint8_t Line)
{
  uint8_t i;
  LCD_Pos(Line,0);
  
  for(i=0;i<16;i++)
    Lcd_Write_Data(0x20);
}
/***************************************************************************************************
  * 描述   : LCD_12864显示字符串
  * 参数   : Line:行 Column：列
  *          汉字：Column范围 0~7   Line范围 0~3
  *          英文：Column范围 0~15  Line范围 0~3
  *           ptr：字符串指针：
  * 返回   : 无
  * 注意   : 汉字：不能超过8个
  *          英文：不能超过16个   
   *************************************************************************************************/
void Display_Str(uint8_t Line,uint8_t Column, uint8_t *ptr)
{						
    LCD_Pos(Line,Column);
    while((*ptr)!='\0')     //字符串没结束
    {
        Lcd_Write_Data(*ptr++);
    }
}
/***************************************************************************************************
  * 描述   : LCD_12864显示数字
  * 参数   : Line:行 Column：列 Column范围 0~15  Line范围 0~3
  *          num :要显示的数字 范围：0~65536 Size: 指定的输出字段的宽度
  *               如果数据的位数小于Size,则左端补以空格，若大于Size,则按实际位数输出
  * 返回   : 无
  * 注意   : 
   *************************************************************************************************/
void LCD_Display_FloatNum(uint8_t Line,uint8_t Column, float num,uint8_t Size)
{
    uint8_t ch[12];
    uint8_t Count=0;//数据位数
    uint32_t Temp;
    uint32_t Temp1;
    //判断是否是负数
    if(num<0.00)
    {
      num=-num;
      Count++;  
      ch[0]='-';//负数
    }
    Temp=(uint32_t)(num*1000);//化为整数,保留3位小数
    //去掉末尾多余0
    ch[11]=3;//计数小数位的位数
	while(Temp%10==0&&ch[11]!=0)
	{
	   Temp=Temp/10;
       ch[11]--;
	}
    //判断是否有小数
    if(ch[11]!=0x00)
       Count++;
    Temp1=Temp;
    do
    {
      Temp = Temp/10;
      Count++;
    }
    while(Temp);
     //位数控制
    if(Size>Count)
    {
      if(ch[0]=='-')
      {
        ch[Size-Count] ='-';//负号移动
      }
      do
      {
        Count++;
        ch[Size-Count] =' ';//空格填补 
      }
      while(Count!=Size);
    }
    ch[Count--] = '\0';
    //如果有小数
    if(ch[11]!=0)
    {
      Temp=ch[11];
      do
      {
        Temp--;
        ch[Count--] =Temp1%10+'0';
        Temp1=Temp1/10;
      }while(Temp!=0);
      ch[Count--]='.';
    }
    do
    {
        ch[Count--] = Temp1%10+'0';
        Temp1=Temp1/10;
    }while(Temp1);
    Display_Str(Line,Column,ch);
    
}
/***************************************************************************************************
  * 描述   : LCD_12864显示数字
  * 参数   : Line:行 Column：列 Column范围 0~15  Line范围 0~3
  *          num :要显示的数字 范围：0~65536 Size: 指定的输出字段的宽度
  *               如果数据的位数小于Size,则左端补以空格，若大于Size,则按实际位数输出
  * 返回   : 无
  * 注意   : 
   *************************************************************************************************/
void LCD_DisplayNum(uint8_t Line,uint8_t Column, uint16_t num,uint8_t Size)
{
    uint8_t ch[5];
    uint8_t Count=0;
    uint16_t temp=num;
    do
    {
        temp = temp/10;
        Count++;
    }
    while(temp);
    //位数控制
    if(Size>Count)
    {
      do
      {
        Count++;
        ch[Size-Count] =' ';//空格填补 
      }
      while(Count!=Size);
    }
    ch[Count] = '\0';
    ch[--Count] = ' ';//防止无法显示
    do
    {
        ch[Count--] =num%10+'0';
        num=num/10;
    }while(num);
    Display_Str(Line,Column,ch);
}
/*-------------------------底层函数---------------------------------------------------------------*/ 

/***************************************************************************************************
  * 描述   : 写命令码
  * 参数   : Cmdcode: 命令码
  * 返回   : 无
  * 注意   : 
   *************************************************************************************************/
static void Lcd_Write_Cmd(uint8_t Cmdcode)
{
    LCD_CS1;
    LCD_SendByte(0xf8);
    LCD_SendByte(Cmdcode & 0xf0);
    LCD_SendByte((Cmdcode << 4) & 0xf0);
    delay_us(LCD_Interval_Delay);
    LCD_CS0;
    delay_us(LCD_Interval_Delay);
}
/***************************************************************************************************
  * 描述   :  向12864写数据
  * 参数   :  Data: 数据
  * 返回   :  无
  * 注意   :
  *************************************************************************************************/
static void Lcd_Write_Data(uint8_t Data)
{
    LCD_CS1;
    LCD_SendByte(0xfa);
    LCD_SendByte(Data & 0xf0);
    LCD_SendByte((Data << 4) & 0xf0);
    delay_us(LCD_Interval_Delay);
    LCD_CS0;
    delay_us(LCD_Interval_Delay);
}
/***************************************************************************************************
  * 描述   :  发送数据流
  * 参数   :  Data: 数据
  * 返回   :  无
  * 注意   :
  *************************************************************************************************/
static void LCD_SendByte(uint8_t Data)
{
  uint8_t i;
  for(i=0; i<8; i++)
  {
    if((Data << i) & 0x80)
    {
      LCD_DAT1;
    }
    else 
    {
      LCD_DAT0;
    }
    LCD_CLK0;
    LCD_CLK1;
  }
}
/******************* (C) 版权 2012 longwei *****文件结束*******************************************/
