/***************************************************************************************************
  * 文    件：7229.h   
  * 作    者：longwei
  * 编写日期：2012/7/9
  * 版    本：V1.0
  * 开 发 板：MSP430G2553 TI开发板
  * 修改时间：无 
  * 编 译 器: IAR.5.20
  *-------------------------------------------------------------------------------------------------
  * 简    介：     
  *************************************************************************************************/
/*包含--------------------------------------------------------------------------------------------*/
#include"HD7279.h" 
/* 私有定义结构体 --------------------------------------------------------------------------------*/
/* 私有宏-----------------------------------------------------------------------------------------*/
#if __USER_DISNUM__
/*数码管编码--------------------------------------------------------------------------------------*/
/*------------------显示位------------------------------------------------------------------------*/
//译码方式选择
#if __7279_Decode==1
#define HD7279_Decode   0x80	//方式0译码
#else 
#define HD7279_Decode 	0xc8	//方式1译码
#endif

#endif
/* 私有变量 --------------------------------------------------------------------------------------*/
KEY_TypeDef KEY={0,0xff};
/* 私有函数模型 ----------------------------------------------------------------------------------*/
static void  HD7279_WriteByte(uint8_t data);
static uint8_t HD7279_GetKeyVal(void);
/***************************************************************************************************
  * 描述   : 初始化HD7279
  * 参数   : 无
  * 返回   : 无
  * 注意   :
  *************************************************************************************************/
void HD7279_Init(void)
{
	//如果不用液晶下行需要被编译
    //HD7279_IO_DIR;//数据IO口配置
    P2DIR &=~BIT2;  //中断线为输入方向
    _BIS_SR(GIE);   //开总中断
    KEY_In_Enable();//中断使能
    P2IES |= BIT2;  //下降沿触发
    P2IFG = 0x00;   //中断标志位清除   
	HD7279_CMD(HD7279_CMD_Reset);//复位
}
/***************************************************************************************************
  * 描述   : 获取按键值
  * 参数   : 无
  * 返回   : 键值
  * 注意   : 该函数只被中断函数调用
  *************************************************************************************************/
static uint8_t HD7279_GetKeyVal(void)
{
  uint8_t KeyValue=0,i;
  //默认使能，下行没有被编译，下同
  //HD7279_CS0;     //使能数据传输
  HD7279_WriteByte(HD7279_CMD_R_Key);  //写读键数据指令15H
  HD7279_DAT_IN;//数据口改为输入模式
  HD7279_CLK0;
  delay_us(25);
  for(i=0;i<8;i++)
  {
	HD7279_CLK1;
	delay_us(8);
	KeyValue<<=1;
	if(HD7279_DAT_R)
	{
		KeyValue+=1;
	}

	HD7279_CLK0;
	delay_us(8);
  }
  //HD7279_CS1;	 //使能
  HD7279_DAT_OUT;//数据口改为输出模式
  return KeyValue;

}
/***************************************************************************************************
  * 描述   :  向HD7279发送命令
  * 参数   :  命令字
  * 返回   :  无
  * 注意   :
  *************************************************************************************************/
void HD7279_CMD(uint8_t cmd)
{
   	//HD7279_CS0;     //电平拉低进入数据传输状态
	delay_us(25);
	HD7279_WriteByte(cmd);  
	//HD7279_CS1;  
}
#if __USER_DISNUM__
/***************************************************************************************************
  * 描述   :  数码管显示
  * 参数   :  位置、数码管的值、小数点是否使能
  * 返回   :  无
  * 注意   :  使用该函数控制宏__USER_DISNUM__需为1
  *************************************************************************************************/
void  LED_Display(uint8_t Location,uint8_t Number,uint8_t Dp)
{
	//HD7279_CS0;     //电平拉低进入数据传输状态
	delay_us(25);
	HD7279_WriteByte(Location+HD7279_Decode);
	if(Dp==0x01)
	   HD7279_WriteByte(Number|0x80);
	else
	   HD7279_WriteByte(Number);  
	//HD7279_CS1;     
}
#endif

/*私有函数----------------------------------------------------------------------------------------*/
/***************************************************************************************************
  * 描述   :  HD7279写数据
  * 参数   :  data 数据
  * 返回   :  无
  * 注意   :
  *************************************************************************************************/
static void  HD7279_WriteByte(uint8_t data)
{		
    uint8_t i;
	for(i=0;i<8;i++)
	{
		if(data&0x80)
		{
		  HD7279_DAT_W1;
		}
		else
	    {
		   HD7279_DAT_W0;
		}
		HD7279_CLK1;
		delay_us(10);
		HD7279_CLK0;
		delay_us(10);
		data=data<<1;
	}
}
/***************************************************************************************************
  * 描述   : 按键中断处理函数
  * 参数   : 无
  * 返回   : 无
  * 注意   :
  *************************************************************************************************/
#pragma vector=PORT2_VECTOR
__interrupt void PORT2_ISR(void)
{  
    KEY.Keynum=HD7279_GetKeyVal();
    KEY.Key_Flag=0x01;
    P2IFG=0x00; 
}
/******************* (C) 版权 2012 longwei *****文件结束*******************************************/
